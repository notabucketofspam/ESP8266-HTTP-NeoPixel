## HTTP-WiFi/main/Kconfig.projbuild
```kconfig
menu "HTTP-WiFi configuration"
  menu "LED configuration"
    config HW_NEOPIXEL_COUNT
      int "LED count"
      range 1 4096
      default 30
      help
        Number of pixels on the strand. Due to the single-strand limit, don't 
        set this too high, or else signal degredation may occur.
        Also, this is used for calculating the size of the stream buffer for
        dynamic patterns.
  endmenu
  menu "WiFi configuration"
    config HW_WIFI_SSID
      string "WiFi SSID"
      default "AzureDiamond"
      help
        Name of the network to connect to.
    config HW_WIFI_PASSWORD
      string "WiFi password"
      default "hunter2"
      help
        "you can go hunter2 my hunter2-ing hunter2"
    menuconfig HW_STATIC_IP_ADDR
      bool "Enable static IP address"
      default n
      help
        Useful for finding the HTTP-WiFi device on a large network. Make sure to
        reserve its MAC on your access point as well, be that the default or a
        custom one set below. Keep addresses in the standard IPv4 notation, 
        as in 192.168.1.1, with leading zeros omitted.
    config HW_IP_ADDR
      depends on HW_STATIC_IP_ADDR
      string "IP address"
      default "192.168.1.2"
    config HW_NETMASK_ADDR
      depends on HW_STATIC_IP_ADDR
      string "Netmask"
      default "255.255.255.0"
    config HW_GW_ADDR
      depends on HW_STATIC_IP_ADDR
      string "Gateway address"
      default "192.168.1.1"
    menuconfig HW_SPECIFY_MAC_ADDR
      bool "Specify MAC address"
      default n
      help
        Whether or not to use the built-in station MAC address or a user-input 
        one. Setting it to true implies the latter.
    config HW_MAC_ADDR
      depends on HW_SPECIFY_MAC_ADDR
      string "MAC address"
      default "1A:2B:3C:4D:5E:6F"
      help
        According to Espressif, bit 0 of byte 0 cannot be 1, i.e. byte 0 cannot
        be an odd number. For example, 1A:xx:xx:xx:xx:xx is acceptable but
        15:xx:xx:xx:xx:xx is not. Also, please keep it in the above format, 
        otherwise things break at runtime.
    choice HW_WIFI_PROTOCOL_SELECT
      prompt "WiFi protocol"
      default HW_WIFI_PROTOCOL_BG
      help
        Which combination of IEEE 802.11 network PHY standards to utilize.
      config HW_WIFI_PROTOCOL_B
        bool "802.11b"
      config HW_WIFI_PROTOCOL_BG
        bool "802.11bg"
      config HW_WIFI_PROTOCOL_BGN
        bool "802.11bgn"
    endchoice
    config HW_WIFI_PROTOCOL
      int
      default 1 if HW_WIFI_PROTOCOL_B
      default 3 if HW_WIFI_PROTOCOL_BG
      default 7 if HW_WIFI_PROTOCOL_BGN
    config HW_WIFI_TIMEOUT
      int "Connection timeout"
      range -1 3600
      default 30
      help
        Time in seconds before WiFi connection is deemed a failure. Setting 
        this to -1 will disable the feature, thus setting the timeout to 
        portMAX_DELAY (effectively infinite).
    config HW_WIFI_RETRY_MAX
      int "Retry connection maximum"
      range -1 1000
      default 10
      help
        Number of times to attempt to connect to WiFi before giving up and
        restarting the device. Setting this to -1 will disable the feature,
        meaning that the device will never restart upon connection failure.
    config HW_WIFI_KEEP_EVENT_HANDLER
      bool "Keep connection event handler"
      default y
      help
        Setting this option to false will deregister the event handler for
        managing WiFi communications once the first connection is made;
        consequently, a small amount of RAM is saved by doing so.
  endmenu
  menu "HTTPD configuration"
    config HW_INDEX_HTML_GET_RESP_BUF_SIZE
      int "index.html GET response buffer size"
      range 1 8192
      default 256
      help
        Size of the buffer used for the response to a GET request for the
        index.html file, or more accurately for the base path which displays
        said file (since index.html redirects to the base path).
    config HW_FAVICON_ICO_GET_RESP_BUF_SIZE
      int "favicon.ico GET response buffer size"
      range 1 8192
      default 256
      help
        Size of the buffer used for the response to a GET request for the
        favicon.ico file, which is requested alongside the base path.
    config HW_HTTPD_REQ_RECV_BUF_SIZE
      int "Form submission POST request receive buffer size"
      range 1 8192
      default 256
      help
        Size of the buffer used for reading content data from a POST request,
        which will subsequently be parsed into pattern commands.
  endmenu
  menu "SPI configuration"
    config HW_SPI_HANDSHAKE
      int "SPI handshake pin"
      range 0 16
      default 5
      help
        This pin connects to the handshake on the NeoPixel device.
        Must be the same between the two if the modules are stacked.
    choice HW_SPI_CLK_DIV_SELECT
      prompt "SPI clock division"
      default HW_SPI_10MHZ
      help
        Understand that it cannot be faster than the NeoPixel device can handle.
        Max recommended is 20 MHz but even that's a bit of a stretch.
      config HW_SPI_2MHZ
        bool "2 MHz"
      config HW_SPI_4MHZ
        bool "4 MHz"
      config HW_SPI_5MHZ
        bool "5 MHz"
      config HW_SPI_8MHZ
        bool "8 MHz"
      config HW_SPI_10MHZ
        bool "10 MHz"
      config HW_SPI_16MHZ
        bool "16 MHz"
      config HW_SPI_20MHZ
        bool "20 MHz"
      config HW_SPI_40MHZ
        bool "40 MHz"
      config HW_SPI_80MHZ
        bool "80 MHz"
    endchoice
    config HW_SPI_CLK_DIV
      int
      default 40 if HW_SPI_2MHZ
      default 20 if HW_SPI_4MHZ
      default 16 if HW_SPI_5MHZ
      default 10 if HW_SPI_8MHZ
      default  8 if HW_SPI_10MHZ
      default  5 if HW_SPI_16MHZ
      default  4 if HW_SPI_20MHZ
      default  2 if HW_SPI_40MHZ
      default  1 if HW_SPI_80MHZ
  endmenu
  menu "FreeRTOS configuration"
    config HW_QUEUE_SIZE
      int "HTTP to SPI queue size"
      range 1 32
      default 4
      help
        Each item in the queue contains one metadata struct and either
        a. one or more static pattern commands
        b. a single dynamic pattern command
    menuconfig HW_ENABLE_STATIC_PATTERN
      bool "Enable static pattern support"
      default y
      help
        Send commands to the NeoPixel device specifying predetermined
        pixel-changing patterns.
    config HW_STATIC_PATTERN_ARRAY_SIZE
      depends on HW_ENABLE_STATIC_PATTERN
      int "Static pattern array size"
      range 1 32
      default 4
      help
        Number of static pattern structs to be able to send grouped together 
        at one time. Each pattern data transmission will have a metadata struct
        and several static pattern structs.
    config HW_ENABLE_DYNAMIC_PATTERN
      bool "Enable dynamic pattern support"
      default n
      help
        Send custom commands directly to the NeoPixel device, allowing for much
        more fine-grained control.
        Please note that this is very computationally expensive in all regards, 
        as well as being experimental / unstable in general. It's primarily
        for the case when OTA updates are in use, and thus only the HTTP-WiFi
        device can be outfitted with new patterns.
  endmenu
endmenu
```

## HTTP-WiFi/sdkconfig.defaults
```kconfig
# Bootloader
CONFIG_LOG_BOOTLOADER_LEVEL_VERBOSEy
CONFIG_LOG_BOOTLOADER_LEVEL=5
# Serial Flasher
CONFIG_ESPTOOLPY_BAUD_2MB=y
CONFIG_ESPTOOLPY_BAUD_OTHER_VAL=115200
CONFIG_ESPTOOLPY_BAUD=2000000
CONFIG_ESPTOOLPY_COMPRESSED=y
CONFIG_ESPTOOLPY_FLASHMODE_QIO=y
CONFIG_ESPTOOLPY_FLASHMODE="dio"
CONFIG_SPI_FLASH_MODE=0x0
CONFIG_ESPTOOLPY_FLASHFREQ_80M=y
CONFIG_ESPTOOLPY_FLASHFREQ="80m"
CONFIG_SPI_FLASH_FREQ=0xf
CONFIG_ESPTOOLPY_FLASHSIZE_4MB=y
CONFIG_ESPTOOLPY_FLASHSIZE="4MB"
CONFIG_SPI_FLASH_SIZE=0x400000
# Partition Table
CONFIG_PARTITION_TABLE_CUSTOM=y
CONFIG_PARTITION_TABLE_CUSTOM_FILENAME="partitions_ota.csv"
CONFIG_PARTITION_TABLE_OFFSET=0x8000
CONFIG_PARTITION_TABLE_FILENAME="partitions_ota.csv"
# ESP8266-specific
CONFIG_ESP8266_XTAL_FREQ_26=y
CONFIG_ESP8266_XTAL_FREQ=26
CONFIG_ESP8266_DEFAULT_CPU_FREQ_160=y
CONFIG_ESP8266_DEFAULT_CPU_FREQ_MHZ=160
# Wi-Fi
CONFIG_WIFI_TX_RATE_SEQUENCE_FROM_HIGH=n
CONFIG_ESP8266_WIFI_DEBUG_LOG_ENABLE=y
CONFIG_ESP8266_WIFI_DEBUG_LOG_VERBOSE=y
# PHY
CONFIG_ESP_PHY_INIT_DATA_IN_PARTITION=y
# Common ESP-related
CONFIG_ESP_CONSOLE_UART_CUSTOM=y
CONFIG_ESP_CONSOLE_UART_CUSTOM_NUM_1=y
CONFIG_ESP_CONSOLE_UART_NUM=1
CONFIG_ESP_CONSOLE_UART_BAUDRATE=115200
# Log output
CONFIG_LOG_DEFAULT_LEVEL_VERBOSE=y
CONFIG_LOG_DEFAULT_LEVEL=5
CONFIG_LOG_COLORS=y
# lwIP
CONFIG_LWIP_DEBUG=y
# mbedTLS
CONFIG_MBEDTLS_SSL_OUT_CONTENT_LEN=4096
CONFIG_MBEDTLS_SSL_IN_CONTENT_LEN=16384
# SPIFFS
CONFIG_USING_SPIFFS=y
CONFIG_SPIFFS_META_LENGTH=0
```

## NeoPixel/main/Kconfig.projbuild
```kconfig
menu "NeoPixel configuration"
  menu "LED configuration"
    config NP_NEOPIXEL_PIN
      int "NeoPixel pin"
      range 0 16
      default 4
      help
        Pin used for the NeoPixel strip. Adafruit recommends using a PWM pin,
        which is pretty much limited to GPIO4 since the rest are used for SPI.
        Only one strand is supported at this time.
    config NP_NEOPIXEL_COUNT
      int "LED count"
      range 1 4096
      default 30
      help
        Number of pixels on the strand. Due to the single-strand limit, don't 
        set this too high, or else signal degredation will occur.
        Also, this is used for calculating the size of the stream buffer for
        all inputs regardless of type.
  endmenu
  menu "SPI configuration"
    config NP_SPI_HANDSHAKE
      int "SPI handshake pin"
      range 0 16
      default 5
      help
        This pin connects to the handshake on the HTTP-WiFi device.
        Must be the same between the two if the modules are stacked.
  endmenu
  menu "FreeRTOS configuration"
    config NP_QUEUE_SIZE
      int "SPI to ANP queue size"
      range 1 32
      default 4
      help
        Each item in the queue contains one metadata struct and either
        a. one or more static pattern commands
        b. a single dynamic pattern command
    menuconfig NP_ENABLE_STATIC_PATTERN
      bool "Enable static pattern support"
      default y
      help
        Receive commands from the HTTP-WiFi device specifying predetermined
        pixel-changing patterns.
    config NP_STATIC_PATTERN_ARRAY_SIZE
      depends on NP_ENABLE_STATIC_PATTERN
      int "Static pattern array size"
      range 1 32
      default 4
      help
        Number of static pattern structs to be able to receive grouped together 
        at one time. Each pattern data transmission will have a metadata struct
        and several static pattern structs.
    config NP_ENABLE_DYNAMIC_PATTERN
      bool "Enable dynamic pattern support"
      default n
      help
        Receive custom commands directly from the HTTP-WiFi device, allowing for much
        more fine-grained control.
        Please note that this is very computationally expensive in all regards, 
        as well as being experimental / unstable in general. It's primarily
        for the case when OTA updates are in use, and thus only the HTTP-WiFi
        device can be outfitted with new patterns.
  endmenu
endmenu
```

## NeoPixel/sdkconfig.defaults
```kconfig
# Bootloader
CONFIG_LOG_BOOTLOADER_LEVEL_VERBOSE=y
CONFIG_LOG_BOOTLOADER_LEVEL=5
# Serial Flasher
CONFIG_ESPTOOLPY_BAUD_2MB=y
CONFIG_ESPTOOLPY_BAUD_OTHER_VAL=115200
CONFIG_ESPTOOLPY_BAUD=2000000
CONFIG_ESPTOOLPY_COMPRESSED=y
CONFIG_ESPTOOLPY_FLASHMODE_DIO=y
CONFIG_ESPTOOLPY_FLASHMODE="dio"
CONFIG_SPI_FLASH_MODE=0x2
CONFIG_ESPTOOLPY_FLASHFREQ_40M=y
CONFIG_ESPTOOLPY_FLASHFREQ="40m"
CONFIG_SPI_FLASH_FREQ=0x0
CONFIG_ESPTOOLPY_FLASHSIZE_4MB=y
CONFIG_ESPTOOLPY_FLASHSIZE="4MB"
CONFIG_SPI_FLASH_SIZE=0x400000
# Partition Table
CONFIG_PARTITION_TABLE_CUSTOM=y
CONFIG_PARTITION_TABLE_CUSTOM_FILENAME="partitions.csv"
CONFIG_PARTITION_TABLE_OFFSET=0x8000
CONFIG_PARTITION_TABLE_FILENAME="partitions.csv"
# ESP8266-specific
CONFIG_ESP8266_XTAL_FREQ_26=y
CONFIG_ESP8266_XTAL_FREQ=26
CONFIG_ESP8266_DEFAULT_CPU_FREQ_160=y
CONFIG_ESP8266_DEFAULT_CPU_FREQ_MHZ=160
# Common ESP-related
CONFIG_ESP_CONSOLE_UART_CUSTOM=y
CONFIG_ESP_CONSOLE_UART_CUSTOM_NUM_1=y
CONFIG_ESP_CONSOLE_UART_NUM=1
CONFIG_ESP_CONSOLE_UART_BAUDRATE=115200
# Log output
CONFIG_LOG_DEFAULT_LEVEL_VERBOSE=y
CONFIG_LOG_DEFAULT_LEVEL=5
CONFIG_LOG_COLORS=y
```

## main/Kconfig.projbuild
```kconfig
menu "Peripheral configuration"

  config NEOPIXEL
    bool "Enable Neopixel"
    default n

endmenu
```
